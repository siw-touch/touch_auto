/*
 * SiW Touch device tree source for Odroid-XU4 (Samsung Exynos5422)
 *
 * Copyright (c) 2016 Silicon Works - http://www.siliconworks.co.kr
 *
 * This program is free software; you can redistribute it and/or modify
 * it under the terms of the GNU General Public License version 2 as
 * published by the Free Software Foundation.
*/
#include <dt-bindings/gpio/gpio.h>

&i2c_1 {					// indicates parent device : I2C_1 adapter block
	sw42101@34 {				// define new client device(sw42101), slave addr is 0x34
		status = "okay";
		compatible = "siw,sw42101";	// compatible name (see touch_sw42101.c)
		reg = <0x34>;				// slave addr. : 0x34
		interrupt-parent = <&gpx1>;	// interrupt source : GPIO group 'gpx1'
		interrupts = <6 0x02>;		// index 6(0~7) in gpx1 external interrupts
		irqflags = <0x2002>;		// IRQF_ONESHOT(0x2000) | IRQF_TRIGGER_FALLING(0x2)

		chip_flags = <0x0000>;

	//	reset-gpio = <&gpx1 7 GPIO_ACTIVE_LOW>;	// index 7 in gpx1
		irq-gpio = <&gpx1 6 GPIO_ACTIVE_LOW>;	// index 6 in gpx1

		// Caps
		max_x = <1920>;
		max_y = <1080>;
		max_pressure = <0xff>;
		max_width = <15>;
		max_orientation = <1>;
		max_id = <10>;
		hw_reset_delay = <1000>;
		sw_reset_delay = <90>;

		// role
		use_lpwg = <0>;
		use_lpwg_test = <0>;

		// firmware
		use_firmware = <1>;		// enable firmware control
		use_fw_upgrade = <0>;		// auto-update during driver initialization
		fw_image = "siw/sw42101/fbp42101_0_01.img";	// in android -> /lib/firmware/siw/...
	//	panel_spec = "siw/sw42101/ph1_limit.txt";
	//	panel_spec_mfts = "siw/sw42101/ph1_limit_mfts.txt";

		//absoulte path
		prd_in_file = "/sdcard/siw/sw42101_test_spec_V0.1.txt";
		prd_in_file_m = "/sdcard/siw/sw42101_test_spec_mfts_V0.1.txt";
		prd_out_file = "/sdcard/siw/touch_self_test.txt";
	};
};





